## arch/arm/mach-msm/display/Kconfig
```kconfig
config FB_MSM_LCDC_LD9040_WVGA
	bool
	select FB_MSM_LCDC_PANEL
	default n

config FB_MSM_LCDC_LD9040_WVGA_PANEL
	depends on FB_MSM_LCDC_HW
	bool "LCDC LD9040 WVGA Panel"
	select FB_MSM_LCDC_LD9040_WVGA
	---help---
	  Support for LCDC LD9040 WVGA (480x800) panel

config FB_MSM_MIPI_DSI_S6E8AA0_WXGA_Q1
        bool 
        select FB_MSM_MIPI_DSI
        select FB_MSM_MIPI_DSI_ESD_REFRESH
        default n

config FB_MSM_MIPI_DSI_ESD_REFRESH
        bool 
        select FB_MSM_MIPI_DSI
        default n

config FB_MSM_MIPI_S6E8AA0_WXGA_Q1_PT
        bool
        select FB_MSM_MIPI_DSI_S6E8AA0_WXGA_Q1
        default n

config FB_MSM_MIPI_S6E8AA0_WXGA_Q1_PANEL
        bool "MIPI S6E8AA0)WXGA_Q1 Panel"
        select FB_MSM_MIPI_S6E8AA0_WXGA_Q1_PT
```

## arch/arm/mach-msm/samsung/Kconfig
```kconfig
config MACH_SAMSUNG
	bool

menu "SAMSUNG Board Selection"
source "arch/arm/mach-msm/samsung/Kconfig.board"
endmenu


menu "SAMSUNG Specific Patches"

choice
	prompt "Target Locale"
	depends on !TARGET_SERIES_DUMMY
	default TARGET_LOCALE_KOR

	config TARGET_LOCALE_KOR
		bool "Locale KOR "
		help
		  Support Korea SKT Board

	config TARGET_LOCALE_USA
		bool "Locale USA "
		help
		  Support USA Board

	config TARGET_LOCALE_JPN
		bool "Locale JPN "
		help
		  Support JPN Board

	config TARGET_LOCALE_EUR
		bool "Locale EUR "
		help
		  Support EUR Board
endchoice

choice
	prompt "Operator in the Korean market"
	default KOR_CARRIER_SKT
	depends on TARGET_LOCALE_KOR

	config KOR_OPERATOR_SKT
		bool "SKT"
	config KOR_OPERATOR_KT
		bool "KT"
	config KOR_OPERATOR_LGU
		bool "LGU"
	config KOR_OPERATOR_OPEN
		bool "OPEN"
endchoice

choice
	prompt "Operator in the USA market"
	default USA_OPERATOR_ATT
	depends on TARGET_LOCALE_USA

	config USA_OPERATOR_ATT
		bool "USA Operator ATT"

	config USA_OPERATOR_TMO
		bool "USA Operator TMO"
		
	config CAN_OPERATOR_RWC
		bool "CAN Operator RWC"			
endchoice

choice
	prompt "Operator in the JPN market"
	default JPN_OPERATOR_NTT
	depends on TARGET_LOCALE_JPN

	config JPN_OPERATOR_NTT
		bool "JPN Operator NTT"
endchoice

choice
	prompt "Operator in the EUR market"
	default EUR_OPERATOR_OPEN
	depends on TARGET_LOCALE_EUR

	config EUR_OPERATOR_OPEN
		bool "OPEN"			
endchoice

config SEC_KERNEL_REBASE_FOR_PMEM_OPTIMIZATION
	bool "Kernel Rebase for PMEM Optimization"
	default n
	help
	  This option is used to place kernel base to 0x48000000 instead of 0x40400000.

config SAMSUNG_MEMORY_LAYOUT_ARRANGE
	bool "Memory Layout Re-arrangement"
	default n
	help
	  This option is used to place kernel base to 0x48000000 instead of 0x40400000.

config SAMSUNG_8X60_TABLET
	bool "SAMSUNG 8X60 TABLET"
	default n

config SEC_AUDIO_DEVICE
	bool "Sec AUDIO DEVICE"
	help
	  Support Sec audio Device

config SEC_AUDIO_I2S_DRIVING_CURRENT
	bool "Sec I2S Driving Current"
	default n
	help
	  Support I2S driving current up

config SEC_EXTRA_VOLUME_SOL
	bool "Sec Extra Volume Solution"
	default n
	help
	  Support Sec Extra Volume Solution

config Q1_KOR_AUDIO
	bool "Q1 KOR AUDIO"
	default n
	help
	  Support Q1 KOR AUDIO

config NOISE_REDUCE_FOR_WIFI_ON
	bool "noise reduce for WIFI on"
	default n
	help
	  Support Q1 LGU+

config SEC_LOG_LAST_KMSG
	default n
	bool "Enable /proc/last_kmsg support: if EMBEDDED"
	help
	  This option enables /proc/last_kmsg support.

config BT_BCM4330
 	bool "Enable BCM4330 driver"
 	default n
 	help
	  Adds BCM4330 RFKILL driver for Broadcom BCM4330 chipset

endmenu

menu "Samsung Debugging Feature"
source "arch/arm/mach-msm/samsung/Kconfig.debug"
endmenu
```

## arch/arm/mach-msm/samsung/Kconfig.board
```kconfig
#
# Inlcude the specific Kconfig file for SAMSUNG board
#

choice
	prompt "Target Series"
	depends on ARCH_MSM8X60
	default TARGET_SERIES_CELOX

	config TARGET_SERIES_CELOX
		select MACH_SAMSUNG
		bool "Celox"
		help
		  Support models of celox series

	config TARGET_SERIES_Q1
		select MACH_SAMSUNG
		bool "Quincy"
		help
		  Support models of q1 series

	config TARGET_SERIES_DUMMY
		bool "(None)"
endchoice

choice
	prompt "KOR Model Name"
	default KOR_MODEL_SHV_E110S
	depends on TARGET_LOCALE_KOR

	config KOR_MODEL_SHV_E110S
		bool "SHV-E110S"
	config KOR_MODEL_SHV_E120S
		bool "SHV-E120S"
	config KOR_MODEL_SHV_E120K
		bool "SHV-E120K"
	config KOR_MODEL_SHV_E120L
		bool "SHV-E120L"
	config KOR_MODEL_SHV_E160S
		bool "SHV-E160S"
	config KOR_MODEL_SHV_E160K
		bool "SHV-E160K"
	config KOR_MODEL_SHV_E160L
		bool "SHV-E160L"
		
endchoice

choice
	prompt "EUR/USA Model Name"
	depends on TARGET_LOCALE_USA

	config USA_MODEL_SGH_I717
		bool "USA ATT SGH-I717"

	config USA_MODEL_SGH_T879
		bool "USA TMO SGH-T879"	
		depends on USA_MODEL_SGH_I717

	config USA_MODEL_SGH_I727
		bool "USA ATT SGH-I727"

	config USA_MODEL_SGH_I727R
		depends on USA_MODEL_SGH_I727
		bool "USA ATT SGH-I727R"

	config EUR_MODEL_GT_I9210
		depends on USA_MODEL_SGH_I727
		bool "EUR OPEN GT-I9210"

	config USA_MODEL_SGH_I757 
		bool "USA ATT SGH-I757"

	config USA_MODEL_SGH_T989
		bool "USA ATT SGH-T989"

	config USA_MODEL_SGH_T989D
		depends on USA_MODEL_SGH_T989
		bool "USA TMO SGH-T989D"

	config USA_MODEL_SGH_T769
		bool "USA TMO SGH-T769"

	config USA_MODEL_SGH_I957
		bool "USA ATT SGH-I957"

	config USA_MODEL_SGH_I577 
		bool "USA ATT SGH-I577"

endchoice

choice
	prompt "JPN Model Name"
	depends on TARGET_LOCALE_JPN

	config JPN_MODEL_SC_01D
		bool "JPN NTT SC-01D"

	config JPN_MODEL_SC_03D
		bool "JPN NTT SC-03D"

endchoice
```

## arch/arm/mach-msm/samsung/Kconfig.debug
```kconfig
menuconfig SEC_DEBUG
	bool "Samsung TN Ramdump Feature"
	default y
	help
	  Samsung TN Ramdump Feature.

config SEC_DEBUG_SCHED_LOG
	bool "Samsung Scheduler Logging Feature"
	depends on SEC_DEBUG
	default y
	help
	  Samsung Scheduler Logging Feature for Debug use.

config SEC_DEBUG_SEMAPHORE_LOG
	bool "Samsung Semaphore Logging Feature"
	depends on SEC_DEBUG
	default n
	help
	  Samsung Semaphore Logging Feature for Debug use.

config SEC_DEBUG_USER
	bool "Panic on Userspace fault"
	depends on SEC_DEBUG
	default y
	help
	  Panic on Userspace fault

config SEC_DEBUG_IRQ_EXIT_LOG
	bool "Temporary Logging for IRQ delay"
	depends on SEC_DEBUG
	default n
	help
	  Verbose Logging for IRQ delay.

config SEC_DEBUG_WORKQ_LOG
	bool "Logging work queue/func information"
	depends on SEC_DEBUG
	default n
	help
	  Verbose Logging work queue/func information.

config SEC_DEBUG_DCVS_LOG
	bool "Temporary Logging for DCVS"
	depends on SEC_DEBUG
	default n
	help
	  Logging feature for DCVS

config SEC_DEBUG_FUELGAUGE_LOG
	bool "Temporary Logging for FuelGauge"
	depends on SEC_DEBUG
	default n
	help
	  Logging feature for FuelGauge

config SEC_DEBUG_MDP_LOG
	bool "Temporary Logging for MDP"
	depends on SEC_DEBUG
	default n
	help
	  Logging feature for MDP

config SEC_DEBUG_POWERCOLLAPSE_LOG
	bool "Temporary Logging for PowerCollaspe"
	depends on SEC_DEBUG
	default n
	help
	  Logging feature for PowerCollapse

config SEC_DEBUG_SDIO_LOG
	bool "Temporary Logging for SDIO"
	depends on SEC_DEBUG
	default n
	help
	  Logging feature for SDIO
```

## drivers/input/keyboard/cypress-touchkey/Kconfig
```kconfig
#
# Cypress touch keypad configuration
#
config KEYPAD_CYPRESS_TOUCH
	tristate "Cypress touch keypad support"
	default n
	help
	  Say Y here if you want to use the Cypress touch keypad.

	  To compile this driver as a module, choose M here: the
	  module will be called melfas-touchkey.
```

## security/sec/Kconfig
```kconfig
config SECURITY_SEC
	bool "Sec Security Support"
        depends on SECURITY
	default n
	help
	  This selects Sec Security Linux.
```
